## conf/layer.conf
```bitbake
# We have a conf and classes directory, add to BBPATH
BBPATH .= ":${LAYERDIR}"

# We have recipes-* directories, add to BBFILES
BBFILES += "${LAYERDIR}/recipes-*/*/*.bb \
            ${LAYERDIR}/recipes-*/*/*.bbappend"

BBFILE_COLLECTIONS += "meta-cva6"
BBFILE_PATTERN_meta-cva6 = "^${LAYERDIR}/"
BBFILE_PRIORITY_meta-cva6 = "6"

LAYERDEPENDS_meta-cva6 = "core"
LAYERSERIES_COMPAT_meta-cva6 = "scarthgap"
```

## conf/machine/cv32a6-agilex7.conf
```bitbake
#@TYPE: Machine
#@NAME: cv32a6-agilex7
#@SOC: cv32a6 agilex7
#@DESCRIPTION: Machine configuration for the CV32A6 core in the Agilex7 board

require conf/machine/include/riscv/tune-riscv.inc

# Selecting riscv 32 bit without hardware floating point support
DEFAULTTUNE = "riscv32nf"
# Forcing arch in compiler argument, some packages (e.g. busybox) are compiling with double instruction (fcvt for busybox)
TUNE_CCARGS:append = "${@bb.utils.contains('TUNE_FEATURES', 'riscv32nf', ' -march=rv32ima', ' ', d)}"

# core-image
MACHINE_FEATURES = "ext2 ext3 serial"

# linux-yocto
KERNEL_CLASSES = "kernel-fitimage"
KERNEL_IMAGETYPE = "fitImage"
UBOOT_ENV = ""
PREFERRED_PROVIDER_virtual/kernel ?= "linux-yocto"
PREFERRED_PROVIDER_virtual/bootloader ?= "u-boot-cva6"

PREFERRED_VERSION_openocd-native = "riscv"
PREFERRED_VERSION_openocd = "riscv"

EXTRA_IMAGEDEPENDS += "opensbi"

# opensbi
RISCV_SBI_PLAT = "generic"

## This sets u-boot as the default OpenSBI payload
RISCV_SBI_PAYLOAD ?= "u-boot.bin"
## This will set the kernel as the OpenSBI payload. This is not recommended,
##  you can use U-Boot's MMC loading instead.
# RISCV_SBI_PAYLOAD ?= "${KERNEL_IMAGETYPE}-${MACHINE}.bin"

RISCV_SBI_FDT ?= "cv32a6_agilex7.dtb"
## Use this to add Microsemi Expansion board support
# RISCV_SBI_FDT ?=  "hifive-unleashed-a00-microsemi.dtb"

# SERIAL_CONSOLES = "115200;ttyS0"

MACHINE_EXTRA_RRECOMMENDS += " kernel-modules"

IMAGE_FSTYPES += "wic.gz wic.bmap ext4"
KERNEL_DEVICETREE ?= "openhwgroup/${RISCV_SBI_FDT}"

## Do not update fstab file when using wic images
WIC_CREATE_EXTRA_ARGS ?= "--no-fstab-update"

EXTRA_IMAGEDEPENDS += "u-boot-cva6"
UBOOT_MACHINE = "openhwgroup_cv32a6_agilex7_defconfig"

# Linux entrypoint
UBOOT_ENTRYPOINT = "0x80400000"
UBOOT_DTB_LOADADDRESS = "0x82400000"

## Set this to "mmc-boot" to generate a boot.scr file which should be included
##  in the boot partition. It will try to load a kernel image by TFTP and if that
##  fails it will fall back to local images in the boot partition.
# UBOOT_ENV ?= "tftp-mmc-boot"

## wic default support
WKS_FILE_DEPENDS ?= " \
    opensbi \
    e2fsprogs-native \
    bmaptool-native \
    agilex7-sd \
"

IMAGE_BOOT_FILES ?= " \
    fw_payload.bin \
    ${KERNEL_IMAGETYPE} \
    ${RISCV_SBI_FDT}  \
    u-boot.itb \
"

WKS_FILE ?= "cva6-agilex7.wks"
```

## conf/machine/cv64a6-genesys2.conf
```bitbake
#@TYPE: Machine
#@NAME: cv64a6-genesys2
#@SOC: cv64a6 genesys2
#@DESCRIPTION: Machine configuration for the CV64A6 core in the GenesysII board

require conf/machine/include/riscv/tune-riscv.inc

# core-image
MACHINE_FEATURES = "ext2 ext3 serial"

# linux-yocto
KERNEL_CLASSES = "kernel-fitimage"
KERNEL_IMAGETYPE = "fitImage"
UBOOT_ENV = ""
PREFERRED_PROVIDER_virtual/kernel ?= "linux-yocto"
PREFERRED_PROVIDER_virtual/bootloader ?= "u-boot-cva6"

PREFERRED_VERSION_openocd-native = "riscv"
PREFERRED_VERSION_openocd = "riscv"

EXTRA_IMAGEDEPENDS += "opensbi"

# opensbi
RISCV_SBI_PLAT = "generic"

## This sets u-boot as the default OpenSBI payload
RISCV_SBI_PAYLOAD ?= "u-boot.bin"
## This will set the kernel as the OpenSBI payload. This is not recommended,
##  you can use U-Boot's MMC loading instead.
# RISCV_SBI_PAYLOAD ?= "${KERNEL_IMAGETYPE}-${MACHINE}.bin"

RISCV_SBI_FDT ?= "cv64a6_genesysII.dtb"
## Use this to add Microsemi Expansion board support
# RISCV_SBI_FDT ?=  "hifive-unleashed-a00-microsemi.dtb"

SERIAL_CONSOLES = "115200;ttyS0"

MACHINE_EXTRA_RRECOMMENDS += " kernel-modules"

IMAGE_FSTYPES += "wic.gz wic.bmap ext4"
KERNEL_DEVICETREE ?= "openhwgroup/${RISCV_SBI_FDT}"

## Do not update fstab file when using wic images
WIC_CREATE_EXTRA_ARGS ?= "--no-fstab-update"

EXTRA_IMAGEDEPENDS += "u-boot-cva6"
UBOOT_MACHINE = "openhwgroup_cv64a6_genesysII_defconfig"

UBOOT_ENTRYPOINT = "0x80200000"
UBOOT_DTB_LOADADDRESS = "0x82200000"

## wic default support
WKS_FILE_DEPENDS ?= " \
    opensbi \
    e2fsprogs-native \
    bmaptool-native \
"

IMAGE_BOOT_FILES ?= " \
    fw_payload.bin \
    ${KERNEL_IMAGETYPE} \
    ${RISCV_SBI_FDT}  \
"

WKS_FILE ?= "cva6-genesys2.wks"
```

## wic/cva6-agilex7.wks
```
# short-description: Create SD card image for CVA6 on Agilex7 board

part /boot --source bootimg-partition --fstype=vfat --label HPS --active --offset 2048s --fixed-size 100M --align 1
part opensbi --source rawcopy --sourceparams="file=fw_payload.bin" --fixed-size 411M --align 1
part kernel --source rawcopy --sourceparams="file=fitImage" --fixed-size 100M --align 1
part / --source rootfs --ondisk mmcblk0 --fstype=ext4 --label root --align 4096 --size 1G

bootloader --ptable msdos
```

## wic/cva6-genesys2-initramfs.wks
```
# short-description: Create SD card image for CVA6 on Genesys2 board

part opensbi --source rawcopy --sourceparams="file=fw_payload.bin" --ondisk mmcblk0 --size 3M --align 1 --part-type 2e54b353-1271-4842-806f-e436d6af6985
part /boot --source bootimg-partition --ondisk mmcblk0 --fstype=vfat --label boot --active --size=100M --align 4096

bootloader --ptable gpt
```
